## boards/zevatronics/universal_nrf_dongle_uf2/Kconfig.universal_nrf_dongle_uf2
```kconfig
# Copyright (c) 2026 Zevatronics
# SPDX-License-Identifier: Apache-2.0

config BOARD_UNIVERSAL_NRF_DONGLE_UF2
	select SOC_NRF52840_QIAA
```

## boards/zevatronics/universal_nrf_dongle_uf2/board.yml
```yaml
# Copyright (c) 2026 Zevatronics
# SPDX-License-Identifier: Apache-2.0

board:
  name: universal_nrf_dongle_uf2
  vendor: zevatronics
  socs:
    - name: nrf52840
```

## boards/zevatronics/universal_nrf_dongle_uf2/universal_nrf_dongle_uf2_defconfig
```kconfig
# Copyright (c) 2026 Zevatronics
# SPDX-License-Identifier: Apache-2.0

CONFIG_ARM_MPU=y
CONFIG_HW_STACK_PROTECTION=y
CONFIG_GPIO=y

CONFIG_USB_DEVICE_MANUFACTURER="Zevatronics"
CONFIG_USB_DEVICE_PRODUCT="SlimeNRF Receiver Universal nRF Dongle"

CONFIG_LED_RGB_COLOR=y

CONFIG_MPSL=y
CONFIG_MPSL_FEM=y
CONFIG_MPSL_FEM_SIMPLE_GPIO=y

#generate for adafruit uf2 bootloader flashing
CONFIG_BUILD_OUTPUT_UF2=y
CONFIG_FLASH_LOAD_OFFSET=0x1000
CONFIG_RADIO_TX_POWER=30
```
